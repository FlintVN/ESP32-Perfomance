## C-IDF/sdkconfig.defaults
```kconfig
# Target
CONFIG_IDF_TARGET="esp32"

# Clock and memory
CONFIG_ESP_DEFAULT_CPU_FREQ_MHZ_240=y

# Watchdog
CONFIG_ESP_TASK_WDT=n
CONFIG_ESP_TASK_WDT_EN=n
CONFIG_ESP_TASK_WDT_PANIC=n
CONFIG_ESP_INT_WDT=n
CONFIG_ESP_INT_WDT_CHECK_CPU1=n
```
